//液晶模块型号：DV12864G-1-PN
//液晶驱动IC:UC1604C，驱动IC的接口方式：串行接口（4线SPI)
//单片机（MCU):STM32F103RB

//--------------------------
#define uchar unsigned char 
#define uint unsigned int
#define ulong unsigned long
//--------------------------
uchar bmp_12864_1[];

//等待按键,3个按键，有任何一个按键按下都可以进入下一步
void waitkey(void)
{
//	repeat:
//		if(key2==1&&key3==1&&key4==1)	goto repeat;
//		else		
            delay_ms(600);
}

//写指令到LCD模块
void transfer_command_lcd(uchar data1)   
{
	uchar i;
	lcd_cs1=0;
	lcd_rs=0;
	for(i=0;i<8;i++)
   {
		lcd_sclk=0;
		if(data1&0x80) lcd_sid=1;
		else lcd_sid=0;
		lcd_sclk=1;
	 	data1<<=1;
   }
	lcd_cs1=1;
}

//写数据到LCD模块
void transfer_data_lcd(uchar data1)
{
	uchar i;
	lcd_cs1=0;
	lcd_rs=1;
	for(i=0;i<8;i++)
   {
		lcd_sclk=0;
		if(data1&0x80) lcd_sid=1;
		else lcd_sid=0;
		lcd_sclk=1;
	 	data1<<=1;
    }
	lcd_cs1=1;
}

//LCD 模块初始化
void initial_lcd()
{
 lcd_reset=0; //低电平复位
 delay_ms(100);
 lcd_reset=1; //复位完毕
 delay_ms(100);
 transfer_command_lcd(0xe2); //软复位
 delay_ms(500); 
 transfer_command_lcd(0x2f); //打开内部升压
 delay_ms(500);
 transfer_command_lcd(0x81); //微调对比度
 transfer_command_lcd(0x45); //微调对比度的值，可设置范围 0x00～0xFF
 transfer_command_lcd(0xeb); //1/9 偏压比（bias）
 transfer_command_lcd(0xc4); //行扫描顺序：从上到下 oxc2
 transfer_command_lcd(0xa0); //列扫描顺序：从左到右
 transfer_command_lcd(0xaf); //开显示 
}
//设置液晶屏的显示地址（page，column）
void lcd_address(uchar page,uchar column)
{
	column=column-1;  							//
	page=page-1;
	transfer_command_lcd(0xb0+page);   				//设置页地址。每页是8行。一个画面的64行被分成8个页。我们平常所说的第1页，在LCD驱动IC里是第0页，所以在这里减去1
	transfer_command_lcd(((column>>4)&0x0f)+0x10);	//设置列地址的高4位
	transfer_command_lcd(column&0x0f);				//设置列地址的低4位
}

//全屏清屏
void clear_screen()
{
	uchar i,j;
 	for(i=0;i<9;i++)
	{
		lcd_address(1+i,1);
		for(j=0;j<192;j++)
		{
			transfer_data_lcd(0x00);
		}
	}
}
//一些出厂电测用的画面，比如全显，隔行显示，隔列显示等等
void full_screen_test(uchar data1,uchar data2)
{
	uchar i,j;
 	for(i=0;i<9;i++)
	{
		lcd_address(1+i,1);
		for(j=0;j<96;j++)
		{
			transfer_data_lcd(data1);
			transfer_data_lcd(data2);
		}
	}
}

//一些出厂电测用的画面，比如全显，隔行显示，隔列显示等等
void test(void)
{
		full_screen_test(0xff,0xff);
		//delay_ms(500);
		waitkey();

		full_screen_test(0x55,0x55);
		//delay_ms(500);
		waitkey();

		full_screen_test(0xaa,0xaa);
		//delay_ms(500);
		waitkey();

		full_screen_test(0xff,0x00);
		//delay_ms(500);
		waitkey();

		full_screen_test(0x00,0xff);
		//delay_ms(500);
		waitkey();

		full_screen_test(0x55,0xaa);
		//delay_ms(500);
		waitkey();

		full_screen_test(0xaa,0x55);
		//delay_ms(500);
		waitkey();
}

//显示128x64点阵图像
void display_graphic_128x64(uchar page,uchar column,uchar *dp)
{
	uint i,j;
	for(j=0;j<8;j++)
	{
		lcd_address(page+j,column);
		for(i=0;i<192;i++)
		{
			transfer_data_lcd(*dp);   
			dp++;
		}
	}          
}

//主程序
int main(void)
{	 

	Stm32_Clock_Init(9); 	//8MHZ*9倍频=72MHz
	delay_init(72);		   	//72MHz
	MCU_Port_initial();

	initial_lcd();
	while(1)
	{
//------图像显示--------------------------------------------------
//-------1.显示1幅图：
		clear_screen();	
		display_graphic_128x64(1,1,bmp_12864_1);
		//delay_ms(500);
		waitkey();

//------电测画面--------------------------------------------------
		clear_screen();	
		test();			//出厂电测画面
	}
}

uchar bmp_12864_1[]={
/*-- 调入了一幅图像：F:\新开发部\显示图案收藏\19264G-1 小熊及 JERRY.bmp --*/
/*-- 宽度 x 高度=192x64 --*/
0xFF,0x01,0x01,0x01,0x01,0x01,0x01,0x81,0xC1,0xE1,0xF1,0xF9,0xF9,0xF9,0xFD,0xFD,
0xFD,0xFD,0xF9,0xF9,0xF1,0xF1,0xE1,0xC1,0xC1,0x41,0x41,0x41,0x41,0x41,0x41,0x41,
0x41,0x41,0xC1,0x81,0x81,0x81,0xC1,0xE1,0xF1,0xF9,0xF9,0xFD,0xFD,0xFD,0xFD,0xFD,
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0x80,0x80,0x80,0x80,0x80,0x80,0x80,0x80,0x80,0x80,0x80,0x80,0x80,0x80,0x80,0xFF 
};
